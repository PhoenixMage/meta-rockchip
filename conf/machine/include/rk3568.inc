## conf/machine/include/rk3568.inc
```bitbake
# Copyright (C) 2020 Garmin Ltd. or its subsidaries
# Released under the MIT license (see COPYING.MIT for the terms)

SOC_FAMILY = "rk3568"

DEFAULTTUNE ?= "cortexa55"

require conf/machine/include/rk356x.inc
require conf/machine/include/soc-family.inc
require conf/machine/include/arm/armv8-2a/tune-cortexa55.inc
require conf/machine/include/rockchip-defaults.inc
require conf/machine/include/rockchip-wic.inc

KBUILD_DEFCONFIG ?= "defconfig"
KERNEL_CLASSES = "kernel-fitimage"
KERNEL_IMAGETYPE = "fitImage"

UBOOT_SUFFIX ?= "itb"
UBOOT_ENTRYPOINT ?= "0x06000000"

PREFERRED_PROVIDER_u-boot ?= "u-boot"
PREFERRED_PROVIDER_virtual/bootloader ?= "u-boot"
PREFERRED_VERSION_u-boot ?= "2023.07-rc3"

PREFERRED_PROVIDER_virtual/kernel ?= "linux-mainline"
PREFERRED_VERSION_linux-collabora ?= "6.4-rc1%"
```

## conf/machine/include/rk3588.inc
```bitbake
# Copyright (C) 2020 Garmin Ltd. or its subsidaries
# Released under the MIT license (see COPYING.MIT for the terms)

SOC_FAMILY = "rk3588"

DEFAULTTUNE ?= "cortexa76-cortexa55-crypto"

require conf/machine/include/soc-family.inc
require conf/machine/include/arm/armv8-2a/tune-cortexa76-cortexa55.inc
require conf/machine/include/rockchip-defaults.inc
require conf/machine/include/rockchip-wic.inc

KBUILD_DEFCONFIG ?= "defconfig"
KERNEL_CLASSES = "kernel-fitimage"
KERNEL_IMAGETYPE = "fitImage"

UBOOT_SUFFIX ?= "itb"
UBOOT_ENTRYPOINT ?= "0x06000000"
```

## conf/machine/include/rock-3.inc
```bitbake
# Add a common override for all Rock 5 machines
MACHINEOVERRIDES =. "rock-3:"

require conf/machine/include/rk3568.inc

MACHINE_EXTRA_RRECOMMENDS += "kernel-modules"
```

## conf/machine/include/rock-5.inc
```bitbake
# Add a common override for all Rock 5 machines
MACHINEOVERRIDES =. "rock-5:"

require conf/machine/include/rk3588.inc

MACHINE_EXTRA_RRECOMMENDS += "kernel-modules"
```

## conf/machine/rock-3a.conf
```bitbake
#@TYPE: Machine
#@NAME: Rock 3A RK3568
#@DESCRIPTION: Rock 3A is a SBC based on the Rockchip RK3568

require conf/machine/include/rock-3.inc

KERNEL_DEVICETREE = "rockchip/rk3568-rock-3a.dts"
UBOOT_MACHINE = "rock-3a-rk3568_defconfig"
```

## conf/machine/rock-5b.conf
```bitbake
#@TYPE: Machine
#@NAME: Rock 5B RK3588
#@DESCRIPTION: Rock 5B is a SBC based on the Rockchip RK3588

require conf/machine/include/rock-5.inc

KERNEL_DEVICETREE = "rockchip/rk3588-rock-5b.dtb"
UBOOT_MACHINE = "rock5b-rk3588_defconfig"

PREFERRED_VERSION_u-boot = "2023.04"
```

## conf/machine/rock-pi-3a.conf
```bitbake
#@TYPE: Machine
#@NAME: Rock 3A RK3568
#@DESCRIPTION: Rock 3 is a Raspberry Pi 4 Alternative based on Rockchip RK3568 Processor.
#
# NOTE: This machine is for Kernel 5.10 and later. If you are using an older
# kernel, see rock-pi-4.conf

require conf/machine/include/rock-3.inc

KERNEL_DEVICETREE = "rockchip/rk3568-rock-3a.dtb"
UBOOT_MACHINE = "rock-3a-rk3568_defconfig"

PREFERRED_VERSION_u-boot = "radxa"

WKS_FILE = "rock-3a.wks"
MACHINE_EXTRA_RRECOMMENDS = "kernel-modules"
```

## wic/rock-3a.wks
```
# Copyright (C) 2019,2020 Garmin Ltd. or its subsidiaries
# Copyright (C) 2021 Trevor Woerner
# Released under the MIT license (see COPYING.MIT for the terms)
#
# Disk layout
# Note that the reference documentation refers to 512 byte disk sectors, but
# wic uses 1KB blocks
#
#   Partition   Start Sector    Number of Sectors
#   loader1     64              8000
#   reserved1   8064            128
#   reserved2   8192            8192
#   loader2     16384           8192
#   atf         24576           8192
#   boot        32768           229376
#   root        262144          -           (suggested)

part loader1    --offset 32K     --fixed-size 4000K            --source rawcopy                                                 --sourceparams="file=${SPL_BINARY}" --no-table
part loader2    --offset 8M   --fixed-size 4096K            --source rawcopy                                                 --sourceparams="file=u-boot.${UBOOT_SUFFIX}" --no-table
part /boot      --offset 16M  --fixed-size 512M --active --source bootimg-partition --fstype=vfat --label boot --use-uuid --sourceparams="loader=u-boot"
part /                        --fixed-size 2G                       --source rootfs            --fstype=ext4 --label root --use-uuid

bootloader --ptable gpt --append="console=tty1 console=${RK_CONSOLE_DEVICE},${RK_CONSOLE_BAUD}n8 rw rootfstype=ext4 init=/sbin/init"
```
